## arch/arm/configs/twrp-matisselte_defconfig
```kconfig
#variant defconfig
CONFIG_SEC_MATISSE_PROJECT=y
CONFIG_MACH_MATISSELTE_OPEN=y
CONFIG_SEC_MATISSELTE_COMMON=y
#CONFIG_MACH_MATISSELTE_ATT=y
#CONFIG_MACH_MATISSELTE_VZW=y
#CONFIG_MACH_MATISSELTE_USC=y
```

## arch/arm/configs/twrp-matissewifi_defconfig
```kconfig
#variant defconfig
CONFIG_MACH_MATISSEWIFI_OPEN=y
CONFIG_SEC_MATISSE_PROJECT=y
CONFIG_SEC_MATISSEWIFI_COMMON=y
#
CONFIG_MACH_MATISSELTE_OPEN=y
CONFIG_SEC_MATISSELTE_COMMON=y
CONFIG_MACH_MATISSELTE_ATT=y
CONFIG_MACH_MATISSELTE_VZW=y
CONFIG_MACH_MATISSELTE_USC=y
#
CONFIG_MACH_MATISSE3G_OPEN=y
```
